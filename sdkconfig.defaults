## sdkconfig.defaults
```kconfig
CONFIG_IDF_TARGET="esp32c6"
CONFIG_ESPTOOLPY_FLASHSIZE_4MB=y
CONFIG_ESPTOOLPY_FLASHMODE_QIO=y
CONFIG_ESPTOOLPY_FLASHFREQ_80M=y
CONFIG_PARTITION_TABLE_CUSTOM=y
CONFIG_PARTITION_TABLE_CUSTOM_FILENAME="partitions.csv"
CONFIG_PARTITION_TABLE_OFFSET=0x8000
CONFIG_PARTITION_TABLE_MD5=y
CONFIG_ESP_CONSOLE_USB_SERIAL_JTAG=y
CONFIG_PANDA_WIFI_CONNECT_TIMEOUT_MS=20000
```

## src/Kconfig.projbuild
```kconfig
menu "PandaDesk"

config PANDA_WIFI_CONNECT_TIMEOUT_MS
    int "Wi-Fi connection timeout before AP fallback (ms)"
    range 1000 60000
    default 20000

endmenu
```
